/ {
	aliases {
		lora0 = &lora;
	};
};

&spi0 {
	pinctrl-0 = <&spi0_default>;
	pinctrl-names = "default";
	status = "okay";

	cs-gpios = <&gpio0 10 GPIO_ACTIVE_LOW>;

	lora: radio@0 {
		reg = <0>;
		compatible = "semtech,sx1276";
		reset-gpios = <&gpio0 11 GPIO_ACTIVE_LOW>;
		dio-gpios =
		/* SX1276 DIO0 */
		<&gpio0 12 (GPIO_PULL_DOWN | GPIO_ACTIVE_HIGH)>;
		spi-max-frequency = <10000000>;
		power-amplifier-output = "pa-boost";
	};

};
